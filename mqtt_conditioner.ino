
#include <ESP8266WiFi.h>
#include <PubSubClient.h>
#include "PinDefinitionsAndMore.h" // Define macros for input and output pin etc.
#include <IRremote.hpp>
#define LED D0

const char* ssid = "ssid"; 
const char* password =  "password";
const char* mqtt_server = "localhost";
const int mqtt_port = 1883;
WiFiClient espClient;
PubSubClient client(espClient);

const uint16_t onBtn[229] = { 3130, 3070, 3080, 4420, 530, 1720, 480, 620, 480, 1770, 430, 670, 430,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 1670, 580 };
const uint16_t offBtn[229] = { 3080, 3070, 3080, 4420, 580, 1670, 580, 520, 580, 1670, 530, 570, 530,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 1720, 480 };
const uint16_t fan1Btn[229] = { 3030, 3120, 3030, 4520, 530, 1670, 530, 620, 480, 1720, 480, 670, 480,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 670, 430 };
const uint16_t fan2Btn[229] = { 3030, 3120, 3030, 4470, 530, 1720, 480, 620, 530, 1670, 530, 620, 480,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 620, 480 };
const uint16_t fan3Btn[229] = { 3080, 3070, 3080, 4420, 630, 1620, 580, 570, 530, 1670, 580, 520, 580,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 720, 380 };
const uint16_t fan4Btn[229] = { 3080, 3020, 3130, 4420, 580, 1670, 580, 520, 580, 1670, 530, 570, 530,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 620, 480 };
const uint16_t coldBtn[229] = { 3080, 3070, 3080, 4420, 530, 1720, 530, 570, 530, 1720, 480, 620, 480,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 670, 480 };
const uint16_t dryBtn[229] = { 3030, 3120, 3030, 4470, 530, 1720, 480, 620, 530, 1670, 530, 570, 530,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 620, 480 };
const uint16_t heatBtn[229] = { 3030, 3120, 3030, 4470, 530, 1720, 530, 620, 480, 1720, 480, 620, 480,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 620, 480 };
const uint16_t coolerBtn[229] = { 3080, 3070, 3030, 4520, 480, 1720, 530, 570, 530, 1720, 530, 570, 530,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 620, 480 };
const uint16_t t27Btn[223] = { 2980, 3170, 2930, 4620, 430, 1820, 430, 670, 430, 1770, 430, 720, 330,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 770, 330 };
const uint16_t t26Btn[229] = { 2980, 3170, 2980, 4520, 480, 1770, 480, 620, 480, 1720, 480, 620, 480,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 1770, 430 };
const uint16_t t25Btn[229] = { 3030, 3120, 2980, 4520, 480, 1770, 480, 620, 480, 1720, 530, 570, 530,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 1770, 480 };
const uint16_t t24Btn[229] = { 3080, 3070, 3030, 4520, 480, 1720, 480, 620, 530, 1720, 480, 620, 530,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 1820, 380 };
const uint16_t t23Btn[229] = { 3030, 3120, 3030, 4470, 480, 1770, 530, 570, 530, 1670, 530, 620, 480,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 1820, 430 };
const uint16_t t22Btn[229] = { 2980, 3170, 3030, 4470, 480, 1770, 530, 570, 480, 1770, 480, 620, 480,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 1770, 430 };
const uint16_t t21Btn[229] = { 3030, 3120, 3030, 4520, 530, 1670, 530, 620, 480, 1720, 530, 570, 530,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 1770, 430 };
const uint16_t t20Btn[229] = { 2980, 3170, 2980, 4570, 430, 1770, 430, 670, 430, 1770, 480, 670, 430,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 1770, 480 };

void setup() {
   pinMode(LED, OUTPUT);
  pinMode(D1,INPUT_PULLUP);
  Serial.begin(115200);
  IrSender.begin();
  WiFi.begin(ssid, password);
  while (WiFi.status() != WL_CONNECTED) 
  {
    delay(500);
    Serial.println("Connecting to WiFi..");
  }
  Serial.print("Connected to WiFi :");
  Serial.println(WiFi.SSID());
  client.setServer(mqtt_server, mqtt_port);
  client.setCallback(MQTTcallback);
  while (!client.connected()) 
  {
    Serial.println("Connecting to MQTT...");
    // if (client.connect("ESP8266", "username", "password")) <- uncomment this if your broker allow connect without password
    if (client.connect("ESP8266", "username", "password")) // <- and comment this
    {
      Serial.println("connected");
    }
    else
    {
      Serial.print("failed with state ");
      Serial.println(client.state());
      delay(2000);
    }
  }
  client.subscribe("lounge/conditioner");
}
void MQTTcallback(char* topic, byte* payload, unsigned int length) 
{
  Serial.print("Message received in topic: ");
  Serial.println(topic);
  Serial.print("Message:");
  String message;
  for (int i = 0; i < length; i++) 
  {
    message = message + (char)payload[i];
  }
  Serial.print(message);
  if (message == "on") {
      IrSender.sendRaw(onBtn, sizeof(onBtn) / sizeof(onBtn[0]), NEC_KHZ);
    } else if (message == "off") {
      IrSender.sendRaw(offBtn, sizeof(offBtn) / sizeof(offBtn[0]), NEC_KHZ);
    } else if (message == "fan1") {
      IrSender.sendRaw(fan1Btn, sizeof(fan1Btn) / sizeof(fan1Btn[0]), NEC_KHZ);
    } else if (message == "fan2") {
      IrSender.sendRaw(fan2Btn, sizeof(fan2Btn) / sizeof(fan2Btn[0]), NEC_KHZ);
    } else if (message == "fan3") {
      IrSender.sendRaw(fan3Btn, sizeof(fan3Btn) / sizeof(fan3Btn[0]), NEC_KHZ);
    } else if (message == "fan4") {
      IrSender.sendRaw(fan4Btn, sizeof(fan4Btn) / sizeof(fan4Btn[0]), NEC_KHZ);
    } else if (message == "cold") {
      IrSender.sendRaw(coldBtn, sizeof(coldBtn) / sizeof(coldBtn[0]), NEC_KHZ);
    } else if (message == "dry") {
      IrSender.sendRaw(dryBtn, sizeof(dryBtn) / sizeof(dryBtn[0]), NEC_KHZ);
    } else if (message == "heat") {
      IrSender.sendRaw(heatBtn, sizeof(heatBtn) / sizeof(heatBtn[0]), NEC_KHZ);
    } else if (message == "cooler") {
      IrSender.sendRaw(coolerBtn, sizeof(coolerBtn) / sizeof(coolerBtn[0]), NEC_KHZ);
    } else if (message == "27") {
      IrSender.sendRaw(t27Btn, sizeof(t27Btn) / sizeof(t27Btn[0]), NEC_KHZ);
    } else if (message == "26") {
      IrSender.sendRaw(t26Btn, sizeof(t26Btn) / sizeof(t26Btn[0]), NEC_KHZ);
    } else if (message == "25") {
      IrSender.sendRaw(t25Btn, sizeof(t25Btn) / sizeof(t25Btn[0]), NEC_KHZ);
    } else if (message == "24") {
      IrSender.sendRaw(t24Btn, sizeof(t24Btn) / sizeof(t24Btn[0]), NEC_KHZ);
    } else if (message == "23") {
      IrSender.sendRaw(t23Btn, sizeof(t23Btn) / sizeof(t23Btn[0]), NEC_KHZ);
    } else if (message == "22") {
      IrSender.sendRaw(t22Btn, sizeof(t22Btn) / sizeof(t22Btn[0]), NEC_KHZ);
    } else if (message == "21") {
      IrSender.sendRaw(t21Btn, sizeof(t21Btn) / sizeof(t21Btn[0]), NEC_KHZ);
    } else if (message == "20") {
      IrSender.sendRaw(t20Btn, sizeof(t20Btn) / sizeof(t20Btn[0]), NEC_KHZ);
    }
 
}
void loop() 
{
  client.loop();
}